VERSION ""

NS_ :

BS_:

BU_:

BO_ 2147500033 lap_time: 8 Vector__XXX
 SG_ ref_time : 39|32@0+ (1,0) [0|0] "" Vector__XXX
 SG_ lap_time : 7|32@0+ (1,0) [0|0] "" Vector__XXX

BO_ 2147500032 lap: 2 Vector__XXX
 SG_ lap : 7|16@0+ (1,0) [0|0] "" Vector__XXX

BA_DEF_  "BusType" STRING ;
BA_DEF_DEF_  "BusType" "CAN";
