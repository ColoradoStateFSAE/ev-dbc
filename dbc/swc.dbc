VERSION ""

NS_ :

BS_:

BU_:

BO_ 2147487744 buttons: 3 Vector__XXX
 SG_ encoder_amount : 15|16@0- (1,0) [0|0] "" Vector__XXX
 SG_ encoder_button : 5|1@0+ (1,0) [0|0] "" Vector__XXX

BA_DEF_  "BusType" STRING ;
BA_DEF_DEF_  "BusType" "CAN";
