VERSION ""

NS_ :

BS_:

BU_:

BO_ 2147487809 diagnostics: 2 Vector__XXX
 SG_ display_temp : 7|16@0- (0.01,0) [0|100] "°C" Vector__XXX
